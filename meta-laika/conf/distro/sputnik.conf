## meta-laika/conf/distro/sputnik.conf
```bitbake
include conf/distro/poky.conf
DISTRO = "sputnik"
DISTRO_NAME = "Sputnik Linux"
DISTRO_VERSION = "1.0"
DISTRO_CODENAME = "Bacon"
SDK_VENDOR = "-sputniksdk"
SDK_VERSION="${DISTRO_VERSION}"
MAINTAINER = "aeybelvarghese@gmail.com"

TARGET_VENDOR = "-sputnik"

# DISTRO_EXTRA_RDEPENDS += " ${SPUTNIK_DEFAULT_EXTRA_RDEPENDS}"
# DISTRO_EXTRA_RRECOMMENDS += " ${SPUTNIK_DEFAULT_EXTRA_RRECOMMENDS}"

DISTRO_FEATURES ?= "${SPUTNIK_DEFAULT_DISTRO_FEATURES} ${DISTRO_FEATURES_LIBC} "

PACKAGE_CLASSES = "package_ipk"
```

## meta-laika/conf/layer.conf
```bitbake
# We have a conf and classes directory, add to BBPATH
BBPATH .= ":${LAYERDIR}"

# We have recipes-* directories, add to BBFILES
BBFILES += "${LAYERDIR}/recipes-*/*/*.bb \
            ${LAYERDIR}/recipes-*/*/*.bbappend"

BBFILE_COLLECTIONS += "meta-laika"
BBFILE_PATTERN_meta-laika = "^${LAYERDIR}/"
BBFILE_PRIORITY_meta-laika = "6"

LAYERDEPENDS_meta-laika = "core"
LAYERSERIES_COMPAT_meta-laika = "scarthgap"

# MMC SPI
KERNEL_DEVICETREE:append = " overlays/mmc_spi.dtbo"
RPI_EXTRA_CONFIG:append = "\ndtoverlay=mmc_spi\n"
```
